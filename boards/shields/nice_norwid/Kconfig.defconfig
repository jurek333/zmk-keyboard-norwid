## boards/shields/nice_norwid/Kconfig.defconfig
```kconfig
if SHIELD_NICE_NORWID

# Enable Zephyr display subsystem
config ZMK_DISPLAY
    default y

# Enable the Sharp LS0xx driver (built into Zephyr)
config LS0XX
    default y

# Optional: use LVGL for UI widgets
config LVGL
    default y

# Enable the Montserrat 48pt font used by the MJ widget.
# Drop to _32 or _24 if you are tight on flash.
config LV_FONT_MONTSERRAT_48
    default y

# MJ widget
config ZMK_WIDGET_MJ
    default y
                        
choice ZMK_DISPLAY_WORK_QUEUE
    default ZMK_DISPLAY_WORK_QUEUE_DEDICATED
endchoice

endif #SHIELD_NICE_NORWID
```

## boards/shields/nice_norwid/Kconfig.shield
```kconfig
config SHIELD_NICE_NORWID
    def_bool $(shields_list_contains,nice_norwid)

if ZMK_DISPLAY

config ZMK_WIDGET_MJ
    bool "Show 'MJ' text on the display"
    default y
    help
      Renders the text "MJ" centered on the Sharp LS0xx display using
      the LVGL Montserrat 48 font.

endif # ZMK_DISPLAY
```

## boards/shields/norwid/Kconfig.defconfig
```kconfig
if SHIELD_NORWID_LEFT

config ZMK_KEYBOARD_NAME
    default "norwid"

config ZMK_SPLIT_ROLE_CENTRAL
    default y

endif

if SHIELD_NORWID_SILENT_LEFT

config ZMK_KEYBOARD_NAME
    default "silent_norwid"

config ZMK_SPLIT_ROLE_CENTRAL
    default y

config ZMK_SPLIT
    default y

config ZMK_DISPLAY
    default y

config SSD1306
    default y

config ZMK_DISPLAY_BLANK_ON_IDLE
    default n

config I2C
    default n

endif

if SHIELD_NORWID_LEFT || SHIELD_NORWID_RIGHT

config ZMK_SPLIT
    default y

config ZMK_DISPLAY

if ZMK_DISPLAY

config SSD1306
    default y

config I2C
    default y

endif # ZMK_DISPLAY

endif

if SHIELD_NICE_VIEW_NORWID

config LV_Z_VDB_SIZE
    default 100

config LV_DPI_DEF
    default 161

config LV_Z_BITS_PER_PIXEL
    default 1

choice LV_COLOR_DEPTH
    default LV_COLOR_DEPTH_1
endchoice

choice ZMK_DISPLAY_WORK_QUEUE
    default ZMK_DISPLAY_WORK_QUEUE_DEDICATED
endchoice

choice ZMK_DISPLAY_STATUS_SCREEN
    default ZMK_DISPLAY_STATUS_SCREEN_CUSTOM
endchoice

config LV_Z_MEM_POOL_SIZE
    default 4096 if ZMK_DISPLAY_STATUS_SCREEN_CUSTOM

config ZMK_DISPLAY_STATUS_SCREEN_CUSTOM
    imply NICE_VIEW_WIDGET_STATUS

config NICE_VIEW_WIDGET_STATUS
    bool "Custom nice!view status widget"
    select LV_FONT_MONTSERRAT_16
    select LV_USE_IMG
    select LV_USE_CANVAS

config NICE_VIEW_WIDGET_INVERTED
    bool "Invert custom status widget colors"

if !ZMK_SPLIT || ZMK_SPLIT_ROLE_CENTRAL

config NICE_VIEW_WIDGET_STATUS
    select LV_FONT_MONTSERRAT_18
    select LV_FONT_MONTSERRAT_14
    select LV_FONT_UNSCII_8
    select ZMK_WPM

endif # !ZMK_SPLIT || ZMK_SPLIT_ROLE_CENTRAL

config ZMK_DISPLAY_STATUS_SCREEN_BUILT_IN
    select LV_FONT_MONTSERRAT_26

endif # SHIELD_NICE_VIEW_NORWID
```

## boards/shields/norwid/Kconfig.shield
```kconfig
config SHIELD_NORWID_LEFT
    def_bool $(shields_list_contains,norwid_left)

config SHIELD_NORWID_SILENT_LEFT
    def_bool $(shields_list_contains,norwid_silent_left)

config SHIELD_NORWID_SILENT_LEFT_LCD
    def_bool $(shields_list_contains,norwid_silent_left_lcd)

config SHIELD_NORWID_RIGHT
    def_bool $(shields_list_contains,norwid_right)
```
