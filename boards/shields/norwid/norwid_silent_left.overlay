#include "norwid.dtsi"

&kscan0 {
    col-gpios
        = <&xiao_d 10 GPIO_ACTIVE_HIGH>
        , <&xiao_d 9 GPIO_ACTIVE_HIGH>
        , <&xiao_d 8 GPIO_ACTIVE_HIGH>
        , <&xiao_d 7 GPIO_ACTIVE_HIGH>
        , <&xiao_d 6 GPIO_ACTIVE_HIGH>
        ;
};

//&pinctrl {
//	spi0_default: spi0_default {
//    	group1 {
//      		psels = <NRF_PSEL(SPIM_SCK, 0, 5)>,
//        		<NRF_PSEL(SPIM_MOSI, 0, 4)>;
//    	};
//  	};
//  	spi0_sleep: spi0_sleep {
//    	group1 {
//      		psels = <NRF_PSEL(SPIM_SCK, 0, 5)>,
//                <NRF_PSEL(SPIM_MOSI, 0, 4)>;
//      			low-power-enable;
//    	};
// 	};
//};

nice_view_spi: &spi0 {
    status = "okay";
    compatible = "nordic,nrf-spim";
    sck-pin = <&xiao_d 5 GPIO_ACTIVE_HIGH>;
    mosi-pin = <&xiao_d 4 GPIO_ACTIVE_HIGH>;
    cs-gpios = <&xiao_d 19 GPIO_ACTIVE_HIGH>;
    miso-pin = <&xiao_d 18 GPIO_ACTIVE_HIGH>;

    ls0xx: ls0xx@0 {
		compatible = "sharp,ls0xx";
		label = "DISPLAY";
		spi-max-frequency = <2000000>;
		reg = <0>;
		width = <160>;
		height = <68>;
	};
};

&xiao_i2c {
    status = "disabled";
};